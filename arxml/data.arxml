AUTOSAR XML
app type VehicleSpeed: category=VALUE
