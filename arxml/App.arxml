AUTOSAR XML
application software component type AppComponent1
  runnable MainRunnable
