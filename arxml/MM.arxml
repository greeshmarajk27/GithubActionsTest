AUTOSAR XML
mm mode STARTUP: mm-mode-id=1
mm mode RUNNING: mm-mode-id=2
