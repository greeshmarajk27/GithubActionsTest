AUTOSAR XML
em-processes:
  em process EmApp1: em-process-priority=10, em-process-state=RUNNING
