AUTOSAR XML
bsw module Com: bsw-vendor-id=30
