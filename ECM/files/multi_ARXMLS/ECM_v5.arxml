AUTOSAR XML (schema 00050)
package /BMW/Boardnet/CommunicationClusters
  can cluster CAN_IPF_32: baudrate=5033000, protocol-name=CAN
    can physical channel CAN_IPF_32: comm-connectors=[con_IPF_HVM_CAN_IPF_32, con_Wallbox_CHAdeMO_CAN_IPF_32]
      frame EAPC_CHDM_H{100..102}: id 0x{100..102}, can-addressing-mode=STANDARD, can-frame-rx-behavior=CAN-20, can-frame-tx-behavior=CAN-20
      frame EAPC_CHDM_H{108..110}: id 0x{108..110}, can-addressing-mode=STANDARD, can-frame-rx-behavior=CAN-20, can-frame-tx-behavior=CAN-20
      frame EAPC_CHDM_H118: id 0x118, can-addressing-mode=STANDARD, can-frame-rx-behavior=CAN-20, can-frame-tx-behavior=CAN-20
      pdu triggering pduTrig_EAPC_CHDM_H{100..102}: pdu=EAPC_CHDM_H{100..102}
      pdu triggering pduTrig_EAPC_CHDM_H{108..110}: pdu=EAPC_CHDM_H{108..110}
      pdu triggering pduTrig_EAPC_CHDM_H118: pdu=EAPC_CHDM_H118
  can cluster EAPC_DC_CAN: baudrate=500000, protocol-name=CAN
    can physical channel EAPC_DC_CAN: comm-connectors=[con_CCU_EAPC_DC_CAN, con_Wallbox_CHAdeMO_EAPC_DC_CAN]
      frame EAPC_CHDM_H{100..102}: id 0x{100..102}, can-addressing-mode=STANDARD, can-frame-rx-behavior=CAN-20, can-frame-tx-behavior=CAN-20
      frame EAPC_CHDM_H{108..110}: id 0x{108..110}, can-addressing-mode=STANDARD, can-frame-rx-behavior=CAN-20, can-frame-tx-behavior=CAN-20
      frame EAPC_CHDM_H118: id 0x118, can-addressing-mode=STANDARD, can-frame-rx-behavior=CAN-20, can-frame-tx-behavior=CAN-20
      frame EAPC_CHDM_H200: id 0x200, can-addressing-mode=STANDARD, can-frame-rx-behavior=CAN-20, can-frame-tx-behavior=CAN-20
      frame EAPC_CHDM_H201: id 0x201, can-addressing-mode=STANDARD, can-frame-rx-behavior=CAN-20, can-frame-tx-behavior=CAN-20
      frame EAPC_CHDM_H208: id 0x208, can-addressing-mode=STANDARD, can-frame-rx-behavior=CAN-20, can-frame-tx-behavior=CAN-20
      frame EAPC_CHDM_H209: id 0x209, can-addressing-mode=STANDARD, can-frame-rx-behavior=CAN-20, can-frame-tx-behavior=CAN-20
      pdu triggering pduTrig_EAPC_CHDM_H{100..102}: pdu=EAPC_CHDM_H{100..102}
      pdu triggering pduTrig_EAPC_CHDM_H{108..110}: pdu=EAPC_CHDM_H{108..110}
      pdu triggering pduTrig_EAPC_CHDM_H118: pdu=EAPC_CHDM_H118
      pdu triggering pduTrig_EAPC_CHDM_H200: pdu=EAPC_CHDM_H200
      pdu triggering pduTrig_EAPC_CHDM_H201: pdu=EAPC_CHDM_H201
      pdu triggering pduTrig_EAPC_CHDM_H208: pdu=EAPC_CHDM_H208
      pdu triggering pduTrig_EAPC_CHDM_H209: pdu=EAPC_CHDM_H209
package /BMW/Boardnet/DataConstrs
  range intDataConstr_0_1: raw 0..1
  range physDataConstr_0_100_percent: phys 0..100 percent
  range physDataConstr_0_1023_ampere: phys 0..1023 ampere
  range physDataConstr_0_200_ampere: phys 0..200 ampere
  range physDataConstr_0_254_minute: phys 0..254 minute
  range physDataConstr_0_2550_second: phys 0..2550 second
  range physDataConstr_0_255_ampere: phys 0..255 ampere
  range physDataConstr_0_255_minute: phys 0..255 minute
  range physDataConstr_0_255_noUnit: phys 0..255
  range physDataConstr_0_600_volt: phys 0..600 volt
  range physDataConstr_0_6553Dot5_kilowatt_hour: phys 0..6553.5 kilowatt_hour
  range physDataConstr_Minus0Dot1_6553Dot4_kilowatt_hour: phys -0.1..6553.4 kilowatt_hour
  range physDataConstr_Minus1_65534_minute: phys -1..65534 minute
  range physDataConstr_Minus255_0_ampere: phys -255..0 ampere
package /BMW/Boardnet/Frames/CAN_IPF_32
  8 x can frame, all with category=APPLICATION, frame-length=8:
    EAPC_CHDM_H100
      pdu to frame mapping p2fmap_EAPC_CHDM_H100: packing-byte-order=little-endian, pdu=EAPC_CHDM_H100, start-position=0
    EAPC_CHDM_H101
      pdu to frame mapping p2fmap_EAPC_CHDM_H101: packing-byte-order=little-endian, pdu=EAPC_CHDM_H101, start-position=0
    EAPC_CHDM_H105
      pdu to frame mapping p2fmap_EAPC_CHDM_H101: packing-byte-order=little-endian, pdu=EAPC_CHDM_H101, start-position=0
    EAPC_CHDM_H102
      pdu to frame mapping p2fmap_EAPC_CHDM_H102: packing-byte-order=little-endian, pdu=EAPC_CHDM_H102, start-position=0
    EAPC_CHDM_H108
      pdu to frame mapping p2fmap_EAPC_CHDM_H108: packing-byte-order=little-endian, pdu=EAPC_CHDM_H108, start-position=0
    EAPC_CHDM_H109
      pdu to frame mapping p2fmap_EAPC_CHDM_H109: packing-byte-order=little-endian, pdu=EAPC_CHDM_H109, start-position=0
    EAPC_CHDM_H110
      pdu to frame mapping p2fmap_EAPC_CHDM_H110: packing-byte-order=little-endian, pdu=EAPC_CHDM_H110, start-position=0
    EAPC_CHDM_H118
      pdu to frame mapping p2fmap_EAPC_CHDM_H118: packing-byte-order=little-endian, pdu=EAPC_CHDM_H118, start-position=0
package /BMW/Boardnet/Frames/EAPC_DC_CAN
  11 x can frame, all with category=APPLICATION, frame-length=8:
    EAPC_CHDM_H100
      pdu to frame mapping p2fmap_EAPC_CHDM_H100: packing-byte-order=little-endian, pdu=EAPC_CHDM_H100, start-position=0
    EAPC_CHDM_H101
      pdu to frame mapping p2fmap_EAPC_CHDM_H101: packing-byte-order=little-endian, pdu=EAPC_CHDM_H101, start-position=0
    EAPC_CHDM_H102
      pdu to frame mapping p2fmap_EAPC_CHDM_H102: packing-byte-order=little-endian, pdu=EAPC_CHDM_H102, start-position=0
    EAPC_CHDM_H108
      pdu to frame mapping p2fmap_EAPC_CHDM_H108: packing-byte-order=little-endian, pdu=EAPC_CHDM_H108, start-position=0
    EAPC_CHDM_H109
      pdu to frame mapping p2fmap_EAPC_CHDM_H109: packing-byte-order=little-endian, pdu=EAPC_CHDM_H109, start-position=0
    EAPC_CHDM_H110
      pdu to frame mapping p2fmap_EAPC_CHDM_H110: packing-byte-order=little-endian, pdu=EAPC_CHDM_H110, start-position=0
    EAPC_CHDM_H118
      pdu to frame mapping p2fmap_EAPC_CHDM_H118: packing-byte-order=little-endian, pdu=EAPC_CHDM_H118, start-position=0
    EAPC_CHDM_H200  # EAPC_DC_CAN
      pdu to frame mapping p2fmap_EAPC_CHDM_H200: packing-byte-order=little-endian, pdu=EAPC_CHDM_H200, start-position=0
    EAPC_CHDM_H201  # EAPC_DC_CAN
      pdu to frame mapping p2fmap_EAPC_CHDM_H201: packing-byte-order=little-endian, pdu=EAPC_CHDM_H201, start-position=0
    EAPC_CHDM_H208  # EAPC_DC_CAN
      pdu to frame mapping p2fmap_EAPC_CHDM_H208: packing-byte-order=little-endian, pdu=EAPC_CHDM_H208, start-position=0
    EAPC_CHDM_H209  # EAPC_DC_CAN
      pdu to frame mapping p2fmap_EAPC_CHDM_H209: packing-byte-order=little-endian, pdu=EAPC_CHDM_H209, start-position=0
package /BMW/Boardnet/ISignalIPduGroups/CCU
  i signal i pdu group CCU_IN_PduGroup_EAPC_CHDM: communication-direction=IN, communication-mode=EAPC_CHDM, i-signal-i-pdus=[EAPC_CHDM_H108, EAPC_CHDM_H109, EAPC_CHDM_H118]
  i signal i pdu group CCU_OUT_PduGroup_EAPC_CHDM: communication-direction=OUT, communication-mode=EAPC_CHDM, i-signal-i-pdus=[EAPC_CHDM_H100, EAPC_CHDM_H101, EAPC_CHDM_H102, EAPC_CHDM_H110]
package /BMW/Boardnet/ISignalIPduGroups/IPF_HVM
  i signal i pdu group IPF_HVM_IN_PduGroup_EAPC_CHDM: communication-direction=IN, communication-mode=EAPC_CHDM, i-signal-i-pdus=[EAPC_CHDM_H108, EAPC_CHDM_H109, EAPC_CHDM_H118]
  i signal i pdu group IPF_HVM_OUT_PduGroup_EAPC_CHDM: communication-direction=OUT, communication-mode=EAPC_CHDM, i-signal-i-pdus=[EAPC_CHDM_H100, EAPC_CHDM_H101, EAPC_CHDM_H102, EAPC_CHDM_H110]
package /BMW/Boardnet/ISignalIPduGroups/Wallbox_CHAdeMO
  i signal i pdu group Wallbox_CHAdeMO_IN_PduGroup_EAPC_CHDM: communication-direction=IN, communication-mode=EAPC_CHDM, i-signal-i-pdus=[EAPC_CHDM_H100, EAPC_CHDM_H101, EAPC_CHDM_H102, EAPC_CHDM_H110]
  i signal i pdu group Wallbox_CHAdeMO_OUT_PduGroup_EAPC_CHDM: communication-direction=OUT, communication-mode=EAPC_CHDM, i-signal-i-pdus=[EAPC_CHDM_H108, EAPC_CHDM_H109, EAPC_CHDM_H118]
package /BMW/Boardnet/ISignals/EAPC_CHDM_H100
  i signal EAPC_CHDM_CHA_RATE_REF_CONST: length=8, base-type=uint8, system-signal=EAPC_CHDM_CHA_RATE_REF_CONST
  i signal EAPC_CHDM_MAX_BT_U: length=16, base-type=uint16, system-signal=EAPC_CHDM_MAX_BT_U
  i signal EAPC_CHDM_MIN_I_CHGNG: length=8, base-type=uint8, system-signal=EAPC_CHDM_MIN_I_CHGNG
package /BMW/Boardnet/ISignals/EAPC_CHDM_H101
  4 x i signal:
    EAPC_CHDM_ESTI_CHGNG_T: data-type-policy=L, length=8, base-type=uint8, system-signal=EAPC_CHDM_ESTI_CHGNG_T
    EAPC_CHDM_MAX_CHGNG_T: length=8, base-type=uint8, system-signal=EAPC_CHDM_MAX_CHGNG_T
    EAPC_CHDM_MAX_CHGNG_T_EXT: length=8, base-type=uint8, system-signal=EAPC_CHDM_MAX_CHGNG_T_EXT
    EAPC_CHDM_TOT_HVSTO_CAPA: length=16, base-type=uint16, system-signal=EAPC_CHDM_TOT_HVSTO_CAPA
package /BMW/Boardnet/ISignals/EAPC_CHDM_H102
  6 x i signal:
    EAPC_CHDM_CHGNG_I_RQ: length=8, base-type=uint8, system-signal=EAPC_CHDM_CHGNG_I_RQ
    EAPC_CHDM_ERR_FLAG: length=8, base-type=uint8, system-signal=EAPC_CHDM_ERR_FLAG
    EAPC_CHDM_INTL_CTR_PRTL_NO_EL_VEH: length=8, base-type=uint8, system-signal=EAPC_CHDM_INTL_CTR_PRTL_NO_EL_VEH
    EAPC_CHDM_SOC: length=8, base-type=uint8, system-signal=EAPC_CHDM_SOC
    EAPC_CHDM_ST_FLAG: length=8, base-type=uint8, system-signal=EAPC_CHDM_ST_FLAG
    EAPC_CHDM_TAR_BT_U: length=16, base-type=uint16, system-signal=EAPC_CHDM_TAR_BT_U
package /BMW/Boardnet/ISignals/EAPC_CHDM_H108
  4 x i signal:
    EAPC_CHDM_AVLB_OUT_I: length=8, base-type=uint8, system-signal=EAPC_CHDM_AVLB_OUT_I
    EAPC_CHDM_AVLB_OUT_U: length=16, base-type=uint16, system-signal=EAPC_CHDM_AVLB_OUT_U
    EAPC_CHDM_EL_VEH_RLY_WELD_DETE_ENB: length=8, base-type=uint8, system-signal=EAPC_CHDM_EL_VEH_RLY_WELD_DETE_ENB
    EAPC_CHDM_THRV_U: length=16, base-type=uint16, system-signal=EAPC_CHDM_THRV_U
package /BMW/Boardnet/ISignals/EAPC_CHDM_H109
  7 x i signal:
    EAPC_CHDM_INTL_CTR_PRTL_NO_CHGNG_UNIT: length=8, base-type=uint8, system-signal=EAPC_CHDM_INTL_CTR_PRTL_NO_CHGNG_UNIT
    EAPC_CHDM_PRES_I: length=8, base-type=uint8, system-signal=EAPC_CHDM_PRES_I
    EAPC_CHDM_PRES_U: length=16, base-type=uint16, system-signal=EAPC_CHDM_PRES_U
    EAPC_CHDM_RSTI_CHGNG_T: length=8, base-type=uint8, system-signal=EAPC_CHDM_RSTI_CHGNG_T
    EAPC_CHDM_RSTI_CHGNG_T_EXT: length=8, base-type=uint8, system-signal=EAPC_CHDM_RSTI_CHGNG_T_EXT
    EAPC_CHDM_ST_ERR_FLAG: length=8, base-type=uint8, system-signal=EAPC_CHDM_ST_ERR_FLAG
    EAPC_EVPSDischargeCompatibilityFlag: length=8, base-type=uint8, invalid-value=value_255:255, system-signal=EAPC_EVPSDischargeCompatibilityFlag
package /BMW/Boardnet/ISignals/EAPC_CHDM_H110
  i signal EAPC_CHDM_CHGNG_I_RQ_EXT: length=16, base-type=uint16, system-signal=EAPC_CHDM_CHGNG_I_RQ_EXT
  i signal EAPC_CHDM_DYN_CTR_VEH: length=1, base-type=uint8, system-signal=EAPC_CHDM_DYN_CTR_VEH
  i signal EAPC_CHDM_HI_I_CTR_VEH: length=1, base-type=uint8, system-signal=EAPC_CHDM_HI_I_CTR_VEH
package /BMW/Boardnet/ISignals/EAPC_CHDM_H118
  5 x i signal:
    EAPC_CHDM_AVLB_OUT_I_EXT: length=16, base-type=uint16, system-signal=EAPC_CHDM_AVLB_OUT_I_EXT
    EAPC_CHDM_DYN_CTR_CHGR: length=1, base-type=uint8, system-signal=EAPC_CHDM_DYN_CTR_CHGR
    EAPC_CHDM_HI_I_CTR_CHGR: length=1, base-type=uint8, system-signal=EAPC_CHDM_HI_I_CTR_CHGR
    EAPC_CHDM_HI_I_CTR_FLAG: length=8, base-type=uint8, system-signal=EAPC_CHDM_HI_I_CTR_FLAG
    EAPC_CHDM_PRES_I_EXT: length=16, base-type=uint16, system-signal=EAPC_CHDM_PRES_I_EXT
package /BMW/Boardnet/ISignals/EAPC_CHDM_H200
  4 x i signal:
    EAPC_MaximumDischargeCurrent: length=8, base-type=uint8, invalid-value=value_255:255, system-signal=EAPC_MaximumDischargeCurrent
    EAPC_MaximumRemainingBatteryCapacityforDischarging: length=8, base-type=uint8, invalid-value=value_255:255, system-signal=EAPC_MaximumRemainingBatteryCapacityforDischarging
    EAPC_MinimumDischargeVoltage: length=16, base-type=uint16, invalid-value=value_65535:65535, system-signal=EAPC_MinimumDischargeVoltage
    EAPC_MinimumRemainingBatteryCapacityforDischarging: length=8, base-type=uint8, invalid-value=value_255:255, system-signal=EAPC_MinimumRemainingBatteryCapacityforDischarging
package /BMW/Boardnet/ISignals/EAPC_CHDM_H201
  i signal EAPC_ApproximateDischargeCompletionTime: length=16, base-type=uint16, invalid-value=value_65535:65535, system-signal=EAPC_ApproximateDischargeCompletionTime
  i signal EAPC_AvailableVehicleEnergy: length=16, base-type=uint16, invalid-value=value_65535:65535, system-signal=EAPC_AvailableVehicleEnergy
  i signal EAPC_V2HChargeDischargeSequenceControlNumber: length=8, base-type=uint8, invalid-value=value_255:255, system-signal=EAPC_V2HChargeDischargeSequenceControlNumber
package /BMW/Boardnet/ISignals/EAPC_CHDM_H208
  4 x i signal:
    EAPC_AvailableInputCurrent: length=8, base-type=uint8, invalid-value=value_255:255, system-signal=EAPC_AvailableInputCurrent
    EAPC_AvailableInputVoltage: length=16, base-type=uint16, invalid-value=value_65535:65535, system-signal=EAPC_AvailableInputVoltage
    EAPC_LowerThresholdVoltage: length=16, base-type=uint16, invalid-value=value_65535:65535, system-signal=EAPC_LowerThresholdVoltage
    EAPC_PresentDischargeCurrent: length=8, base-type=uint8, invalid-value=value_255:255, system-signal=EAPC_PresentDischargeCurrent
package /BMW/Boardnet/ISignals/EAPC_CHDM_H209
  i signal EAPC_RemainingDischargingTime: length=16, base-type=uint16, invalid-value=value_65535:65535, system-signal=EAPC_RemainingDischargingTime
  i signal EAPC_V2HChargeDischargeSequenceControlNumberEVPS: length=8, base-type=uint8, invalid-value=value_255:255, system-signal=EAPC_V2HChargeDischargeSequenceControlNumberEVPS
package /BMW/Boardnet/PDUs
  pdu EAPC_CHDM_H100: length=8, transmission-mode-true-timing=cyclic-timing=time-period={tolerance=absolute-tolerance=0.01, value=0.1}, unused-bit-pattern=255  # @Symphony.CustomCommModePduGroup=EAPC_CHDM;
    mapping EAPC_CHDM_MIN_I_CHGNG: i-signal=EAPC_CHDM_MIN_I_CHGNG, packing-byte-order=little-endian, start-position=0
    mapping EAPC_CHDM_MAX_BT_U: i-signal=EAPC_CHDM_MAX_BT_U, packing-byte-order=little-endian, start-position=32
    mapping EAPC_CHDM_CHA_RATE_REF_CONST: i-signal=EAPC_CHDM_CHA_RATE_REF_CONST, packing-byte-order=little-endian, start-position=48
  pdu EAPC_CHDM_H101: length=8, transmission-mode-true-timing=cyclic-timing=time-period={tolerance=absolute-tolerance=0.01, value=0.1}, unused-bit-pattern=255  # @Symphony.CustomCommModePduGroup=EAPC_CHDM;
    mapping EAPC_CHDM_MAX_CHGNG_T: i-signal=EAPC_CHDM_MAX_CHGNG_T, packing-byte-order=little-endian, start-position=8
    mapping EAPC_CHDM_MAX_CHGNG_T_EXT: i-signal=EAPC_CHDM_MAX_CHGNG_T_EXT, packing-byte-order=little-endian, start-position=16
    mapping EAPC_CHDM_ESTI_CHGNG_T: i-signal=EAPC_CHDM_ESTI_CHGNG_T, packing-byte-order=little-endian, start-position=24
    mapping EAPC_CHDM_TOT_HVSTO_CAPA: i-signal=EAPC_CHDM_TOT_HVSTO_CAPA, packing-byte-order=little-endian, start-position=40
  pdu EAPC_CHDM_H102: length=8, transmission-mode-true-timing=cyclic-timing=time-period={tolerance=absolute-tolerance=0.01, value=0.1}, unused-bit-pattern=255  # @Symphony.CustomCommModePduGroup=EAPC_CHDM;
    mapping EAPC_CHDM_INTL_CTR_PRTL_NO_EL_VEH: i-signal=EAPC_CHDM_INTL_CTR_PRTL_NO_EL_VEH, packing-byte-order=little-endian, start-position=0
    mapping EAPC_CHDM_TAR_BT_U: i-signal=EAPC_CHDM_TAR_BT_U, packing-byte-order=little-endian, start-position=8
    mapping EAPC_CHDM_CHGNG_I_RQ: i-signal=EAPC_CHDM_CHGNG_I_RQ, packing-byte-order=little-endian, start-position=24
    mapping EAPC_CHDM_ERR_FLAG: i-signal=EAPC_CHDM_ERR_FLAG, packing-byte-order=little-endian, start-position=32
    mapping EAPC_CHDM_ST_FLAG: i-signal=EAPC_CHDM_ST_FLAG, packing-byte-order=little-endian, start-position=40
    mapping EAPC_CHDM_SOC: i-signal=EAPC_CHDM_SOC, packing-byte-order=little-endian, start-position=48
  pdu EAPC_CHDM_H108: length=8, transmission-mode-true-timing=cyclic-timing=time-period={tolerance=absolute-tolerance=0.01, value=0.1}, unused-bit-pattern=255  # @Symphony.CustomCommModePduGroup=EAPC_CHDM;
    mapping EAPC_CHDM_EL_VEH_RLY_WELD_DETE_ENB: i-signal=EAPC_CHDM_EL_VEH_RLY_WELD_DETE_ENB, packing-byte-order=little-endian, start-position=0
    mapping EAPC_CHDM_AVLB_OUT_U: i-signal=EAPC_CHDM_AVLB_OUT_U, packing-byte-order=little-endian, start-position=8
    mapping EAPC_CHDM_AVLB_OUT_I: i-signal=EAPC_CHDM_AVLB_OUT_I, packing-byte-order=little-endian, start-position=24
    mapping EAPC_CHDM_THRV_U: i-signal=EAPC_CHDM_THRV_U, packing-byte-order=little-endian, start-position=32
  pdu EAPC_CHDM_H109: length=8, transmission-mode-true-timing=cyclic-timing=time-period={tolerance=absolute-tolerance=0.01, value=0.1}, unused-bit-pattern=255  # @Symphony.CustomCommModePduGroup=EAPC_CHDM;
    mapping EAPC_CHDM_INTL_CTR_PRTL_NO_CHGNG_UNIT: i-signal=EAPC_CHDM_INTL_CTR_PRTL_NO_CHGNG_UNIT, packing-byte-order=little-endian, start-position=0
    mapping EAPC_CHDM_PRES_U: i-signal=EAPC_CHDM_PRES_U, packing-byte-order=little-endian, start-position=8
    mapping EAPC_CHDM_PRES_I: i-signal=EAPC_CHDM_PRES_I, packing-byte-order=little-endian, start-position=24
    mapping EAPC_EVPSDischargeCompatibilityFlag: i-signal=EAPC_EVPSDischargeCompatibilityFlag, packing-byte-order=little-endian, start-position=32
    mapping EAPC_CHDM_ST_ERR_FLAG: i-signal=EAPC_CHDM_ST_ERR_FLAG, packing-byte-order=little-endian, start-position=40
    mapping EAPC_CHDM_RSTI_CHGNG_T: i-signal=EAPC_CHDM_RSTI_CHGNG_T, packing-byte-order=little-endian, start-position=48
    mapping EAPC_CHDM_RSTI_CHGNG_T_EXT: i-signal=EAPC_CHDM_RSTI_CHGNG_T_EXT, packing-byte-order=little-endian, start-position=56
  pdu EAPC_CHDM_H110: length=8, transmission-mode-true-timing=cyclic-timing=time-period={tolerance=absolute-tolerance=0.01, value=0.1}, unused-bit-pattern=255  # @Symphony.CustomCommModePduGroup=EAPC_CHDM;
    mapping EAPC_CHDM_DYN_CTR_VEH: i-signal=EAPC_CHDM_DYN_CTR_VEH, packing-byte-order=little-endian, start-position=0
    mapping EAPC_CHDM_HI_I_CTR_VEH: i-signal=EAPC_CHDM_HI_I_CTR_VEH, packing-byte-order=little-endian, start-position=1
    mapping EAPC_CHDM_CHGNG_I_RQ_EXT: i-signal=EAPC_CHDM_CHGNG_I_RQ_EXT, packing-byte-order=little-endian, start-position=8
  pdu EAPC_CHDM_H118: length=8, transmission-mode-true-timing=cyclic-timing=time-period={tolerance=absolute-tolerance=0.01, value=0.1}, unused-bit-pattern=255  # @Symphony.CustomCommModePduGroup=EAPC_CHDM;
    mapping EAPC_CHDM_DYN_CTR_CHGR: i-signal=EAPC_CHDM_DYN_CTR_CHGR, packing-byte-order=little-endian, start-position=0
    mapping EAPC_CHDM_HI_I_CTR_CHGR: i-signal=EAPC_CHDM_HI_I_CTR_CHGR, packing-byte-order=little-endian, start-position=1
    mapping EAPC_CHDM_AVLB_OUT_I_EXT: i-signal=EAPC_CHDM_AVLB_OUT_I_EXT, packing-byte-order=little-endian, start-position=8
    mapping EAPC_CHDM_PRES_I_EXT: i-signal=EAPC_CHDM_PRES_I_EXT, packing-byte-order=little-endian, start-position=24
    mapping EAPC_CHDM_HI_I_CTR_FLAG: i-signal=EAPC_CHDM_HI_I_CTR_FLAG, packing-byte-order=little-endian, start-position=40
  pdu EAPC_CHDM_H200: length=8, transmission-mode-true-timing=cyclic-timing=time-period={tolerance=absolute-tolerance=0.01, value=0.1}, unused-bit-pattern=255
    mapping EAPC_MaximumDischargeCurrent: i-signal=EAPC_MaximumDischargeCurrent, packing-byte-order=little-endian, start-position=0
    mapping EAPC_MinimumDischargeVoltage: i-signal=EAPC_MinimumDischargeVoltage, packing-byte-order=little-endian, start-position=32
    mapping EAPC_MinimumRemainingBatteryCapacityforDischarging: i-signal=EAPC_MinimumRemainingBatteryCapacityforDischarging, packing-byte-order=little-endian, start-position=48
    mapping EAPC_MaximumRemainingBatteryCapacityforDischarging: i-signal=EAPC_MaximumRemainingBatteryCapacityforDischarging, packing-byte-order=little-endian, start-position=56
  pdu EAPC_CHDM_H201: length=8, transmission-mode-true-timing=cyclic-timing=time-period={tolerance=absolute-tolerance=0.01, value=0.1}, unused-bit-pattern=255
    mapping EAPC_V2HChargeDischargeSequenceControlNumber: i-signal=EAPC_V2HChargeDischargeSequenceControlNumber, packing-byte-order=little-endian, start-position=0
    mapping EAPC_ApproximateDischargeCompletionTime: i-signal=EAPC_ApproximateDischargeCompletionTime, packing-byte-order=little-endian, start-position=8
    mapping EAPC_AvailableVehicleEnergy: i-signal=EAPC_AvailableVehicleEnergy, packing-byte-order=little-endian, start-position=24
  pdu EAPC_CHDM_H208: length=8, transmission-mode-true-timing=cyclic-timing=time-period={tolerance=absolute-tolerance=0.01, value=0.1}, unused-bit-pattern=255
    mapping EAPC_PresentDischargeCurrent: i-signal=EAPC_PresentDischargeCurrent, packing-byte-order=little-endian, start-position=0
    mapping EAPC_AvailableInputVoltage: i-signal=EAPC_AvailableInputVoltage, packing-byte-order=little-endian, start-position=8
    mapping EAPC_AvailableInputCurrent: i-signal=EAPC_AvailableInputCurrent, packing-byte-order=little-endian, start-position=24
    mapping EAPC_LowerThresholdVoltage: i-signal=EAPC_LowerThresholdVoltage, packing-byte-order=little-endian, start-position=48
  pdu EAPC_CHDM_H209: length=8, transmission-mode-true-timing=cyclic-timing=time-period={tolerance=absolute-tolerance=0.01, value=0.1}, unused-bit-pattern=255
    mapping EAPC_V2HChargeDischargeSequenceControlNumberEVPS: i-signal=EAPC_V2HChargeDischargeSequenceControlNumberEVPS, packing-byte-order=little-endian, start-position=0
    mapping EAPC_RemainingDischargingTime: i-signal=EAPC_RemainingDischargingTime, packing-byte-order=little-endian, start-position=8
package /BMW/Boardnet/SystemSignals
  45 x system signal:
    EAPC_ApproximateDischargeCompletionTime: compu-method=EAPC_ApproximateDischargeCompletionTime, data-constr=physDataConstr_Minus1_65534_minute  # Voraussichtliche Entladungs-Abschlusszeit; ========== Expected discharge completion time;
    EAPC_AvailableInputCurrent: compu-method=EAPC_AvailableInputCurrent, data-constr=physDataConstr_Minus255_0_ampere  # Verfügbarer Eingangsstrom; ========== Available input current;
    EAPC_AvailableInputVoltage: compu-method=EAPC_AvailableInputVoltage, data-constr=physDataConstr_0_600_volt  # Verfügbare Eingangsspannung; ========== Available input voltage;
    EAPC_AvailableVehicleEnergy: compu-method=EAPC_AvailableVehicleEnergy, data-constr=physDataConstr_Minus0Dot1_6553Dot4_kilowatt_hour  # Verfügbare Fahrzeugenergie; ========== Available vehicle energy;
    EAPC_CHDM_AVLB_OUT_I: compu-method=EAPC_CHDM_AVLB_OUT_I, data-constr=physDataConstr_0_255_ampere  # EAPC_ChademoAvailableOutputCurrent | LogicalInterface:BMW.INFRASTRUCTURE.HIGHVOLTAGE.Charging[internal]@Infrastruktur;
    EAPC_CHDM_AVLB_OUT_I_EXT: compu-method=EAPC_CHAdeMO_2, data-constr=physDataConstr_0_1023_ampere  # EAPC_ChademoAvailableOutputCurrentExt | LogicalInterface:BMW.INFRASTRUCTURE.HIGHVOLTAGE.Charging[internal]@Infrastruktur; Verfügbarer Ladestrom ========== LogicalInterface:BMW.INFRASTRUCTURE.HIGHVOLTAGE.Charging[internal]@Infrastruktur; Available charging current
    EAPC_CHDM_AVLB_OUT_U: compu-method=EAPC_CHDM_AVLB_OUT_U, data-constr=physDataConstr_0_600_volt  # EAPC_ChademoAvailableOutputVoltage | LogicalInterface:BMW.INFRASTRUCTURE.HIGHVOLTAGE.Charging[internal]@Infrastruktur;
    EAPC_CHDM_CHA_RATE_REF_CONST: compu-method=EAPC_CHDM_TOT_BT_CAPA, data-constr=physDataConstr_0_100_percent  # EAPC_ChademoChargedRateReferenceConstant | LogicalInterface:BMW.INFRASTRUCTURE.HIGHVOLTAGE.Charging[internal]@Infrastruktur; Charged rate reference constant ========== LogicalInterface:BMW.INFRASTRUCTURE.HIGHVOLTAGE.Charging[internal]@Infrastruktur; Charged rate reference constant
    EAPC_CHDM_CHGNG_I_RQ: compu-method=EAPC_CHDM_CHGNG_I_RQ, data-constr=physDataConstr_0_255_ampere  # EAPC_ChademoChargingCurrentRequest | LogicalInterface:BMW.INFRASTRUCTURE.HIGHVOLTAGE.Charging[internal]@Infrastruktur;
    EAPC_CHDM_CHGNG_I_RQ_EXT: compu-method=EAPC_CHAdeMO_2, data-constr=physDataConstr_0_1023_ampere  # EAPC_ChademoChargingCurrentRequestExt | LogicalInterface:BMW.INFRASTRUCTURE.HIGHVOLTAGE.Charging[internal]@Infrastruktur; Angeforderder Ladestrom ========== LogicalInterface:BMW.INFRASTRUCTURE.HIGHVOLTAGE.Charging[internal]@Infrastruktur; Requested charging current
    EAPC_CHDM_DYN_CTR_CHGR: compu-method=EAPC_CHAdeMO_1, data-constr=intDataConstr_0_1  # EAPC_ChademoDynamicControlCharger | LogicalInterface:BMW.INFRASTRUCTURE.HIGHVOLTAGE.Charging[internal]@Infrastruktur; Unterstützung dynamische Regelung durch Ladestation ========== LogicalInterface:BMW.INFRASTRUCTURE.HIGHVOLTAGE.Charging[internal]@Infrastruktur; Support of dynamic control through charging station
    EAPC_CHDM_DYN_CTR_VEH: compu-method=EAPC_CHAdeMO_1, data-constr=intDataConstr_0_1  # EAPC_ChademoDynamicControlVehicle | LogicalInterface:BMW.INFRASTRUCTURE.HIGHVOLTAGE.Charging[internal]@Infrastruktur; Unterstützung dynamische Regelung durch Fahrzeug ========== LogicalInterface:BMW.INFRASTRUCTURE.HIGHVOLTAGE.Charging[internal]@Infrastruktur; Support of dynamic control through vehicle
    EAPC_CHDM_EL_VEH_RLY_WELD_DETE_ENB: compu-method=EAPC_CHDM_EL_VEH_RLY_WELD_DETE_ENB, data-constr=physDataConstr_0_255_noUnit  # EAPC_ChademoElectricVehicleRelayWeldingDetectionEnable | LogicalInterface:BMW.INFRASTRUCTURE.HIGHVOLTAGE.Charging[internal]@Infrastruktur;
    EAPC_CHDM_ERR_FLAG: compu-method=EAPC_CHDM_ERR_FLAG  # EAPC_ChademoErrorFlag | LogicalInterface:BMW.INFRASTRUCTURE.HIGHVOLTAGE.Charging[internal]@Infrastruktur;
    EAPC_CHDM_ESTI_CHGNG_T: compu-method=EAPC_CHDM_ESTI_CHGNG_T, data-constr=physDataConstr_0_254_minute  # EAPC_ChademoEstimatedChargingTime | LogicalInterface:BMW.INFRASTRUCTURE.HIGHVOLTAGE.Charging[internal]@Infrastruktur; Dieses Signal wird nur für die Anzeige ausgewertet. Erwartete Zeitdauer bis zum Ladeende. ========== LogicalInterface:BMW.INFRASTRUCTURE.HIGHVOLTAGE.Charging[internal]@Infrastruktur; This signal is evaluated only for the display. Expected duration until the end of charging.
    EAPC_CHDM_HI_I_CTR_CHGR: compu-method=EAPC_CHAdeMO_1, data-constr=intDataConstr_0_1  # EAPC_ChademoHighCurrentControlCharger | LogicalInterface:BMW.INFRASTRUCTURE.HIGHVOLTAGE.Charging[internal]@Infrastruktur; Unterstützung hoher Ladeströme durch Ladestation ========== LogicalInterface:BMW.INFRASTRUCTURE.HIGHVOLTAGE.Charging[internal]@Infrastruktur; Support of high charging currents through charging station
    EAPC_CHDM_HI_I_CTR_FLAG: compu-method=EAPC_HighCurrentControlCondFlags  # EAPC_ChademoHighCurrentControlCondFlags | LogicalInterface:BMW.INFRASTRUCTURE.HIGHVOLTAGE.Charging[internal]@Infrastruktur; Flags zur Überwachung des Hochstromladens ========== LogicalInterface:BMW.INFRASTRUCTURE.HIGHVOLTAGE.Charging[internal]@Infrastruktur; Flags for monitoring the high-current charging
    EAPC_CHDM_HI_I_CTR_VEH: compu-method=EAPC_CHAdeMO_1, data-constr=intDataConstr_0_1  # EAPC_ChademoHighCurrentControlVehicle | LogicalInterface:BMW.INFRASTRUCTURE.HIGHVOLTAGE.Charging[internal]@Infrastruktur; Unterstützung hoher Ladeströme durch Fahrzeug ========== LogicalInterface:BMW.INFRASTRUCTURE.HIGHVOLTAGE.Charging[internal]@Infrastruktur; Support of high charging currents through vehicle
    EAPC_CHDM_INTL_CTR_PRTL_NO_CHGNG_UNIT: compu-method=EAPC_CHDM_INTL_CTR_PRTL_NO_CHGNG_UNIT, data-constr=physDataConstr_0_255_noUnit  # EAPC_ChademoInternalControlProtokolNumberChargingUnit | LogicalInterface:BMW.INFRASTRUCTURE.HIGHVOLTAGE.Charging[internal]@Infrastruktur;
    EAPC_CHDM_INTL_CTR_PRTL_NO_EL_VEH: compu-method=EAPC_CHDM_INTL_CTR_PRTL_NO_EL_VEH, data-constr=physDataConstr_0_255_noUnit  # EAPC_ChademoInternalControlProtocolNumberElectricVehicle | LogicalInterface:BMW.INFRASTRUCTURE.HIGHVOLTAGE.Charging[internal]@Infrastruktur;
    EAPC_CHDM_MAX_BT_U: compu-method=EAPC_CHDM_MAX_BT_U, data-constr=physDataConstr_0_600_volt  # EAPC_ChademoMaximumBatteryVoltage | LogicalInterface:BMW.INFRASTRUCTURE.HIGHVOLTAGE.Charging[internal]@Infrastruktur;
    EAPC_CHDM_MAX_CHGNG_T: compu-method=EAPC_CHDM_MAX_CHGNG_T, data-constr=physDataConstr_0_2550_second  # EAPC_ChademoMaximumChargingTime | LogicalInterface:BMW.INFRASTRUCTURE.HIGHVOLTAGE.Charging[internal]@Infrastruktur;
    EAPC_CHDM_MAX_CHGNG_T_EXT: compu-method=EAPC_CHDM_MAX_CHGNG_T_EXT, data-constr=physDataConstr_0_255_minute  # EAPC_ChademoMaximumChargingTimeExtended | LogicalInterface:BMW.INFRASTRUCTURE.HIGHVOLTAGE.Charging[internal]@Infrastruktur; Dieses Signal wird nur ausgewertet, wenn das Signal <<Maximum Charging Time>> den Wert FF aufweist. ========== LogicalInterface:BMW.INFRASTRUCTURE.HIGHVOLTAGE.Charging[internal]@Infrastruktur; This signal is evaluated only if the signal <<Maximum Charging Time>> has the value FF.
    EAPC_CHDM_MIN_I_CHGNG: compu-method=EAPC_MinimumChargeCurrent, data-constr=physDataConstr_0_200_ampere  # EAPC_ChademoMinimumChargeCurrent | LogicalInterface:BMW.INFRASTRUCTURE.HIGHVOLTAGE.Charging[internal]@Infrastruktur; Minimaler Ladestrom des Fahrzeugs ========== LogicalInterface:BMW.INFRASTRUCTURE.HIGHVOLTAGE.Charging[internal]@Infrastruktur; Minimum charging current of the vehicle
    EAPC_CHDM_PRES_I: compu-method=EAPC_CHDM_PRES_I, data-constr=physDataConstr_0_255_ampere  # EAPC_ChademoPresentCurrent | LogicalInterface:BMW.INFRASTRUCTURE.HIGHVOLTAGE.Charging[internal]@Infrastruktur;
    EAPC_CHDM_PRES_I_EXT: compu-method=EAPC_CHAdeMO_2, data-constr=physDataConstr_0_1023_ampere  # EAPC_ChademoPresentChargingCurrentExt | LogicalInterface:BMW.INFRASTRUCTURE.HIGHVOLTAGE.Charging[internal]@Infrastruktur; Aktueller Ladestrom ========== LogicalInterface:BMW.INFRASTRUCTURE.HIGHVOLTAGE.Charging[internal]@Infrastruktur; Current charging current
    EAPC_CHDM_PRES_U: compu-method=EAPC_CHDM_PRES_U, data-constr=physDataConstr_0_600_volt  # EAPC_ChademoPresentVoltage | LogicalInterface:BMW.INFRASTRUCTURE.HIGHVOLTAGE.Charging[internal]@Infrastruktur;
    EAPC_CHDM_RSTI_CHGNG_T: compu-method=EAPC_CHDM_RSTI_CHGNG_T, data-constr=physDataConstr_0_2550_second  # EAPC_ChademoResidualTimeChargingTime | LogicalInterface:BMW.INFRASTRUCTURE.HIGHVOLTAGE.Charging[internal]@Infrastruktur;
    EAPC_CHDM_RSTI_CHGNG_T_EXT: compu-method=EAPC_CHDM_RSTI_CHGNG_T_EXT, data-constr=physDataConstr_0_255_minute  # EAPC_ChademoResidualTimeChargingTimeExtended | LogicalInterface:BMW.INFRASTRUCTURE.HIGHVOLTAGE.Charging[internal]@Infrastruktur;
    EAPC_CHDM_SOC: compu-method=EAPC_CHDM_RQUAN_BT_CAPA, data-constr=physDataConstr_0_100_percent  # EAPC_ChademoStateOfCharge | LogicalInterface:BMW.INFRASTRUCTURE.HIGHVOLTAGE.Charging[internal]@Infrastruktur; Charged rate ========== LogicalInterface:BMW.INFRASTRUCTURE.HIGHVOLTAGE.Charging[internal]@Infrastruktur; Charged rate
    EAPC_CHDM_ST_ERR_FLAG: compu-method=EAPC_CHDM_ST_ERR_FLAG  # EAPC_ChademoStatusErrorFlag | LogicalInterface:BMW.INFRASTRUCTURE.HIGHVOLTAGE.Charging[internal]@Infrastruktur;
    EAPC_CHDM_ST_FLAG: compu-method=EAPC_CHDM_ST_FLAG  # EAPC_ChademoStatusFlag | LogicalInterface:BMW.INFRASTRUCTURE.HIGHVOLTAGE.Charging[internal]@Infrastruktur;
    EAPC_CHDM_TAR_BT_U: compu-method=EAPC_CHDM_TAR_BT_U, data-constr=physDataConstr_0_600_volt  # EAPC_ChademoTargetBatteryVoltage | LogicalInterface:BMW.INFRASTRUCTURE.HIGHVOLTAGE.Charging[internal]@Infrastruktur;
    EAPC_CHDM_THRV_U: compu-method=EAPC_CHDM_THRV_U, data-constr=physDataConstr_0_600_volt  # EAPC_ChademoThresholdValueVoltage | LogicalInterface:BMW.INFRASTRUCTURE.HIGHVOLTAGE.Charging[internal]@Infrastruktur;
    EAPC_CHDM_TOT_HVSTO_CAPA: compu-method=EAPC_TotalCapacityOfTractionBatt, data-constr=physDataConstr_0_6553Dot5_kilowatt_hour  # EAPC_ChademoTotalCapacityOfTractionBatt | LogicalInterface:BMW.INFRASTRUCTURE.HIGHVOLTAGE.Charging[internal]@Infrastruktur; Kapazität des HV-Speichers ========== LogicalInterface:BMW.INFRASTRUCTURE.HIGHVOLTAGE.Charging[internal]@Infrastruktur; Capacitance of the high voltage battery
    EAPC_EVPSDischargeCompatibilityFlag: compu-method=EAPC_EVPSDischargeCompatibilityFlag, data-constr=intDataConstr_0_1  # Entladungskompatibilitätsflag EVPS; ========== Discharge compatibility flag EVPS
    EAPC_LowerThresholdVoltage: compu-method=EAPC_LowerThresholdVoltage, data-constr=physDataConstr_0_600_volt  # Untere Spannungsschwelle; ========== Lower voltage threshold;
    EAPC_MaximumDischargeCurrent: compu-method=EAPC_MaximumDischargeCurrent, data-constr=physDataConstr_Minus255_0_ampere  # Maximaler Entladestrom des Fahrzeugs; ========== Maximum discharge current of the vehicle;
    EAPC_MaximumRemainingBatteryCapacityforDischarging: compu-method=EAPC_MaximumRemainingBatteryCapacityforDischarging, data-constr=physDataConstr_0_100_percent  # Maximale verbleibende Batteriekapazität zum Entladen; ========== Maximum remaining battery capacity to discharge;
    EAPC_MinimumDischargeVoltage: compu-method=EAPC_MinimumDischargeVoltage, data-constr=physDataConstr_0_600_volt  # Minimale Entladespannung des Fahrzeugs; ========== Minimum discharge voltage of the vehicle;
    EAPC_MinimumRemainingBatteryCapacityforDischarging: compu-method=EAPC_MinimumRemainingBatteryCapacityforDischarging, data-constr=physDataConstr_0_100_percent  # Minimale verbleibende Batteriekapazität zum Entladen; ========== Minimum remaining battery capacity to discharge;
    EAPC_PresentDischargeCurrent: compu-method=EAPC_PresentDischargeCurrent, data-constr=physDataConstr_Minus255_0_ampere  # Aktueller Entladestrom; ========== Current discharge current;
    EAPC_RemainingDischargingTime: compu-method=EAPC_RemainingDischargingTime, data-constr=physDataConstr_Minus1_65534_minute  # Verbleibende Entladezeit; ========== Remaining discharge time
    EAPC_V2HChargeDischargeSequenceControlNumber: compu-method=EAPC_V2HChargeDischargeSequenceControlNumber, data-constr=physDataConstr_0_255_noUnit  # V2H Sequenz Kontrollnummer Fahrzeug; ========== V2H sequence control number vehicle;
    EAPC_V2HChargeDischargeSequenceControlNumberEVPS: compu-method=EAPC_V2HChargeDischargeSequenceControlNumberEVPS, data-constr=physDataConstr_0_255_noUnit  # V2H Sequenz Kontrollnummer EVPS; ========== V2H sequence control number EVPS
