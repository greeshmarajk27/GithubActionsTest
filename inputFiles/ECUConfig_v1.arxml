AUTOSAR XML (schema 4-1-2)
package /MyEcu
  ecuc value collection MyEcu0: ecu-extract=SYSTEM, ecuc-values=[CanIf, Com]
  module config Com
    ComConfig ()
      3 x ComIPdu:
        Message1: ComIPduDirection=SEND, ComIPduSignalCHANGERef=Signal1, ComIPduSignalRef=Signal5, ComPduIdRef=message1
        Message2: ComIPduDirection=RECEIVE, ComIPduSignalRef=Signal2, ComIPduSignalRef=Signal3, ComIPduSignalRef=Signal4, ComPduIdRef=message2, ComPduIdRef12=message212
        Message3: ComIPduDirection=RECEIVE, ComPduIdRef=message3
      5 x ComSignal:
        Signal1: ComBitPosition=4, ComBitSize=3, ComSignalEndianness=BIG_ENDIAN, ComSignalType=UINT8
        Signal2: ComBitPosition=18, ComBitSize=11, ComSignalEndianness=LITTLE_ENDIAN, ComSignalType=SINT16
        Signal3: ComBitPosition=6, ComBitSize=2, ComSignalEndianness=LITTLE_ENDIAN, ComSignalType=UINT8
        Signal4: ComBitPosition=30, ComBitSize=4, ComSignalEndianness=LITTLE_ENDIAN, ComSignalType=UINT8
        Signal5: ComBitPosition=16, ComBitSize=32, ComSignalEndianness=LITTLE_ENDIAN, ComSignalType=FLOAT32
  module config CanIf
    CanIfInitCfg
      message1_Tx (CanIfTxPduCfg): CanIfTxPduCanId=5, CanIfTxPduCanIdType=STANDARD_CAN, CanIfTxPduDlc=6, CanIfTxPduRef=message1
      message2_Rx (CanIfRxPduCfg): CanIfRxPduCanId=6, CanIfRxPduCanIdType=EXTENDED_CAN, CanIfRxPduDlc=7, CanIfRxPduRef=message2
      message3_Rx (CanIfRxPduCfg): CanIfRxPduCanId=100, CanIfRxPduCanIdType=STANDARD_CAN, CanIfRxPduDlc=8, CanIfRxPduRef=message3
